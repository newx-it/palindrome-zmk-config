## boards/quark-works/palindrome/Kconfig.palindrome_right
```kconfig
# Copyright (c) 2026 Brandon Beltran
# SPDX-License-Identifier: MIT

config BOARD_PALINDROME_RIGHT
    select SOC_NRF52840_QIAA
```

## boards/quark-works/palindrome/board.yml
```yaml
boards:
 - name: palindrome_left
   vendor: quark-works
   socs:
   - name: nrf52840
 - name: palindrome_right
   vendor: quark-works
   socs:
   - name: nrf52840
```

## boards/shields/palindrome/Kconfig.defconfig
```kconfig
# Copyright (c) 2026 Brandon Beltran
# SPDX-License-Identifier: MIT

if SHIELD_PALINDROME_DONGLE

config ZMK_KEYBOARD_NAME
    default "Palindrome"

config ZMK_SPLIT_ROLE_CENTRAL
    default y

config ZMK_SPLIT
    default y

config ZMK_SPLIT_BLE_CENTRAL_PERIPHERALS
    default 3

config BT_MAX_CONN
    default 3

config BT_MAX_PAIRED
    default 3

endif

if BOARD_PALINDROME_LEFT || BOARD_PALINDROME_RIGHT

config BOARD
    default "palindrome"

config ZMK_SPLIT
    default y

config BT_CTLR
    default BT

if USB_DEVICE_STACK

config USB_NRFX
    default y

endif # USB

endif
```

## boards/shields/palindrome/Kconfig.palindrome_left
```kconfig
# Copyright (c) 2026 Brandon Beltran
# SPDX-License-Identifier: MIT

config BOARD_PALINDROME_LEFT
    select SOC_NRF52840_QIAA
    select ZMK_BOARD_COMPAT
```
